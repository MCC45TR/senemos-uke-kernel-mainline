// SPDX-License-Identifier: GPL-2.0-only
/* Exact O82-42 OEM timing groups; retain 120 Hz as the preferred mode. */
#if O82_PANEL_VARIANT != 42
#error OEM refresh modes require the observed O82-42 panel
#endif
#include "sm7675-uke-native-display.dtso"

&uke_panel {
	/delete-property/ xiaomi,initial-60hz-only;
	xiaomi,oem-refresh-modes;
};
