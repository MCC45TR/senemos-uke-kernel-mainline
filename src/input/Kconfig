## src/input/Kconfig
```kconfig
# SPDX-License-Identifier: GPL-2.0-or-later
config VIDEO_NT36532_UKE_THP
	tristate "Uke NT36532 raw THP capture"
	depends on SPI && OF && GPIOLIB && INPUT && VIDEO_DEV && POWER_SUPPLY && DRM_PANEL_XIAOMI_O82
	select VIDEOBUF2_VMALLOC
	select CRYPTO_LIB_SHA256
	help
	  Capture complete Uke NT36532 normal-firmware packets as V4L2 metadata.
	  This requires the matching privileged contact processor and private
	  stock firmware. Checked firmware gestures use an independent wake input;
	  contact decoding remains in the matching privileged processor.
	  Leave disabled until the replacement and rollback paths are qualified.
```
