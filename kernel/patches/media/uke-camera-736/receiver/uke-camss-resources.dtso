// SPDX-License-Identifier: GPL-2.0-only
// SM7675 camera receiver resources for the fitted Uke board.
// The early boot graph keeps this unbound until the camera IFE DMA owner and
// both endpoint graphs are available. All OEM camera devices stay disabled.
#include <dt-bindings/clock/qcom,sm7675-camcc.h>
#include <dt-bindings/clock/qcom,gcc-cliffs.h>
#include <dt-bindings/interrupt-controller/arm-gic.h>
#include <dt-bindings/interrupt-controller/irq.h>

/dts-v1/;
/plugin/;

&{/soc} {
	#address-cells = <1>;
	#size-cells = <1>;

	uke_camss: isp@acb6000 {
		compatible = "qcom,sm7675-camss";
		reg = <0x0acb6000 0x1000>,
		      <0x0acb8000 0x0d00>, <0x0acba000 0x0d00>, <0x0acbc000 0x0d00>,
		      <0x0accb000 0x0a00>, <0x0acd0000 0x0a00>,
		      <0x0ace4000 0x2000>, <0x0ace6000 0x2000>, <0x0ace8000 0x2000>,
		      <0x0acea000 0x2000>, <0x0acec000 0x2000>,
		      <0x0ac62000 0xf000>, <0x0ac71000 0xf000>, <0x0ac80000 0xf000>,
		      <0x0accc000 0x1800>, <0x0acd1000 0x1800>;
		reg-names = "csid_wrapper",
			    "csid0", "csid1", "csid2", "csid_lite0", "csid_lite1",
			    "csiphy0", "csiphy1", "csiphy2", "csiphy3", "csiphy4",
			    "vfe0", "vfe1", "vfe2", "vfe_lite0", "vfe_lite1";

		clocks = <&camcc CAM_CC_CAMNOC_AXI_RT_CLK>,
			 <&camcc CAM_CC_CPAS_AHB_CLK>, <&camcc CAM_CC_CPAS_FAST_AHB_CLK>,
			 <&camcc CAM_CC_CPAS_IFE_0_CLK>, <&camcc CAM_CC_CPAS_IFE_1_CLK>,
			 <&camcc CAM_CC_CPAS_IFE_2_CLK>, <&camcc CAM_CC_CPAS_IFE_LITE_CLK>,
			 <&camcc CAM_CC_CSID_CLK>,
			 <&camcc CAM_CC_CSIPHY0_CLK>, <&camcc CAM_CC_CSI0PHYTIMER_CLK>,
			 <&camcc CAM_CC_CSIPHY1_CLK>, <&camcc CAM_CC_CSI1PHYTIMER_CLK>,
			 <&camcc CAM_CC_CSIPHY2_CLK>, <&camcc CAM_CC_CSI2PHYTIMER_CLK>,
			 <&camcc CAM_CC_CSIPHY3_CLK>, <&camcc CAM_CC_CSI3PHYTIMER_CLK>,
			 <&camcc CAM_CC_CSIPHY4_CLK>, <&camcc CAM_CC_CSI4PHYTIMER_CLK>,
			 <&camcc CAM_CC_CSID_CSIPHY_RX_CLK>, <&gcc GCC_CAMERA_HF_AXI_CLK>,
			 <&camcc CAM_CC_QDSS_DEBUG_XO_CLK>,
			 <&camcc CAM_CC_IFE_0_CLK>, <&camcc CAM_CC_IFE_0_FAST_AHB_CLK>,
			 <&camcc CAM_CC_IFE_1_CLK>, <&camcc CAM_CC_IFE_1_FAST_AHB_CLK>,
			 <&camcc CAM_CC_IFE_2_CLK>, <&camcc CAM_CC_IFE_2_FAST_AHB_CLK>,
			 <&camcc CAM_CC_IFE_LITE_CLK>, <&camcc CAM_CC_IFE_LITE_AHB_CLK>,
			 <&camcc CAM_CC_IFE_LITE_CPHY_RX_CLK>, <&camcc CAM_CC_IFE_LITE_CSID_CLK>;
		clock-names = "camnoc_axi", "cpas_ahb", "cpas_fast_ahb",
			      "cpas_vfe0", "cpas_vfe1", "cpas_vfe2", "cpas_vfe_lite", "csid",
			      "csiphy0", "csiphy0_timer", "csiphy1", "csiphy1_timer",
			      "csiphy2", "csiphy2_timer", "csiphy3", "csiphy3_timer",
			      "csiphy4", "csiphy4_timer", "csiphy_rx", "gcc_axi_hf", "qdss_debug_xo",
			      "vfe0", "vfe0_fast_ahb", "vfe1", "vfe1_fast_ahb",
			      "vfe2", "vfe2_fast_ahb",
			      "vfe_lite", "vfe_lite_ahb", "vfe_lite_cphy_rx", "vfe_lite_csid";

		interrupt-parent = <&intc>;
		interrupts = <GIC_SPI 601 IRQ_TYPE_EDGE_RISING>, <GIC_SPI 603 IRQ_TYPE_EDGE_RISING>,
			     <GIC_SPI 431 IRQ_TYPE_EDGE_RISING>, <GIC_SPI 605 IRQ_TYPE_EDGE_RISING>,
			     <GIC_SPI 376 IRQ_TYPE_EDGE_RISING>,
			     <GIC_SPI 477 IRQ_TYPE_EDGE_RISING>, <GIC_SPI 478 IRQ_TYPE_EDGE_RISING>,
			     <GIC_SPI 479 IRQ_TYPE_EDGE_RISING>, <GIC_SPI 448 IRQ_TYPE_EDGE_RISING>,
			     <GIC_SPI 122 IRQ_TYPE_EDGE_RISING>,
			     <GIC_SPI 602 IRQ_TYPE_EDGE_RISING>, <GIC_SPI 604 IRQ_TYPE_EDGE_RISING>,
			     <GIC_SPI 688 IRQ_TYPE_EDGE_RISING>, <GIC_SPI 606 IRQ_TYPE_EDGE_RISING>,
			     <GIC_SPI 377 IRQ_TYPE_EDGE_RISING>;
		interrupt-names = "csid0", "csid1", "csid2", "csid_lite0", "csid_lite1",
				  "csiphy0", "csiphy1", "csiphy2", "csiphy3", "csiphy4",
				  "vfe0", "vfe1", "vfe2", "vfe_lite0", "vfe_lite1";
		power-domains = <&camcc CAM_CC_IFE_0_GDSC>, <&camcc CAM_CC_IFE_1_GDSC>,
				<&camcc CAM_CC_IFE_2_GDSC>, <&camcc CAM_CC_TITAN_TOP_GDSC>;
		power-domain-names = "ife0", "ife1", "ife2", "top";

		/* The native SM7675 descriptor uses the same two rails on all five PHYs. */
		vdd-csiphy-0p9-supply = <&pmxr2230_l2>;
		vdd-csiphy-1p2-supply = <&pmxr2230_l4>;
		/* HLOS APPSS -> CAMERA_CFG and camera HF -> EBI1 from the fitted CPAS graph. */
		interconnects = <&gem_noc 2 0 &cnoc_cfg 516>,
				<&mmss_noc 11 &mc_virt 512 0>;
		interconnect-names = "ahb", "hf_mnoc";
		iommus = <&apps_smmu 0x800 0x20>;
		dma-coherent;

		status = "disabled";
	};
};
